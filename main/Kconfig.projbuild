## tests/realdevice/data-child/sdkconfig.defaults
```kconfig
CONFIG_IDF_TARGET="esp32c3"
CONFIG_ESPTOOLPY_FLASHSIZE_8MB=y
CONFIG_ESPTOOLPY_HEADER_FLASHSIZE_UPDATE=n
CONFIG_PARTITION_TABLE_CUSTOM=y
CONFIG_PARTITION_TABLE_CUSTOM_FILENAME="partitions.csv"
CONFIG_COMPILER_OPTIMIZATION_SIZE=y
# 行协议(HELLO/INFO/WRITE/READ/ERASE/REBOOT)跑在 USB Serial/JTAG 控制台上:
# 主机 runtime driver / data_child_serial.py 全靠它取证与驱动。
# 2026-10-12 真机:CONSOLE_NONE 时子固件静默,BOOT 后永远等不到 READY。
CONFIG_ESP_CONSOLE_USB_SERIAL_JTAG=y
CONFIG_ESP_CONSOLE_NONE=n
CONFIG_ESP_CONSOLE_SECONDARY_NONE=y
CONFIG_LOG_DEFAULT_LEVEL_WARN=y
```
